#include <zephyr/dt-bindings/pwm/pwm.h>

/* PWM MCU de secours only: manually fit R7 and remove R8 first.
 * No automatic failover or concurrent panel/MCU backlight source.
 * Audit proposal: 4 ms / 250 Hz active high; 1% = 40 us > 33 us
 * recommended TPS7510x minimum on-time. Not physically qualified.
 * zephyr,user is an inspectable proposal; the app does not consume it. */
&pwm0 {
	status = "okay";
};

/ {
	zephyr,user {
		pwms = <&pwm0 0 PWM_MSEC(4) PWM_POLARITY_NORMAL>;
	};
};

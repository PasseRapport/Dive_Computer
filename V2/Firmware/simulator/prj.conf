## CMakeLists.txt
```
cmake_minimum_required(VERSION 3.20.0)
find_package(Zephyr REQUIRED HINTS $ENV{ZEPHYR_BASE})
project(dive_watch_lvgl)
target_sources(app PRIVATE src/light_editor.c src/compass_ring.c src/appearance_checks.c src/battery_icon.c src/main.c src/scuba_model.c src/scuba_dashboard.c src/scuba_presentation.c src/scuba_ui.c src/scuba_checks.c src/compass_ui.c src/sim_dive.c src/watch_ui.c src/apnea_main.c src/apnea_stats.c src/apnea_settings.c src/apnea_checks.c src/apnea_persistence_checks.c src/apnea_settings_checks.c src/dive_layout.c src/sim_controls.c src/sim_checks.c src/v1_ui_layout.c src/selection.c
    src/assets/montserrat_60.c src/assets/montserrat_84.c src/assets/project_logo.c
    src/assets/icon_drop.c src/assets/icon_wave.c src/assets/icon_sun.c src/assets/turn_fish.c
    src/assets/icon_tank.c src/assets/icon_apnea.c src/assets/icon_scuba.c
    src/assets/icon_compass.c src/assets/icon_options.c src/assets/icon_watch.c)
target_sources(native_simulator INTERFACE ${CMAKE_CURRENT_SOURCE_DIR}/src/sim_host.c ${CMAKE_CURRENT_SOURCE_DIR}/src/apnea_preferences_host.c)
# NCS 3.4.1 lists the GIF decoder but omits LVGL 9.5's moved GIF widget.
# Include that widget locally rather than modifying the installed SDK.
target_sources(app PRIVATE ${ZEPHYR_LVGL_MODULE_DIR}/src/widgets/gif/lv_gif.c)

# The calculated PC path runs in native_sim's host runner, using the same
# portable archive as the headless tests. No OSTC globals enter Zephyr/LVGL.
if(DIVE_BENCH)
    if(NOT EXISTS "${DIVE_OSTC4_LIBDIR}/libostc4_exposure.a")
        message(FATAL_ERROR "Build the OSTC4 exposure archive through launch.py --bench")
    endif()
    target_compile_definitions(app PRIVATE DIVE_PC_BENCH=1 OSTC4_TISSUE_CORRECTIONS=1)
    target_include_directories(app PRIVATE "${CMAKE_CURRENT_SOURCE_DIR}/../ostc4_baseline/include")
    target_sources(app PRIVATE src/pc_bench_ui.c src/pc_bench_checks.c src/scuba_calculated.c)
    target_sources(native_simulator INTERFACE "${CMAKE_CURRENT_SOURCE_DIR}/src/pc_bench.c"
        "${CMAKE_CURRENT_SOURCE_DIR}/src/pc_bench_checkpoint_file.c"
        "${CMAKE_CURRENT_SOURCE_DIR}/src/pc_bench_storage.c")
    target_compile_options(native_simulator INTERFACE -DDIVE_PC_BENCH=1 -DOSTC4_TISSUE_CORRECTIONS=1
        "-I${CMAKE_CURRENT_SOURCE_DIR}/../ostc4_baseline/include")
    set_property(TARGET native_simulator APPEND PROPERTY RUNNER_LINK_LIBRARIES
        "${DIVE_OSTC4_LIBDIR}/libostc4_exposure.a"
        "${DIVE_OSTC4_LIBDIR}/libostc4_upstream_contained.a")
    target_link_options(native_simulator INTERFACE -lm)
endif()

target_sources(app PRIVATE src/analog_clock.c src/assets/project_logo_alpha.c)

target_sources(app PRIVATE src/assets/montserrat_bold_28.c)

# Live watch faces and native preference adapter.
target_sources(app PRIVATE src/watch_faces.c src/watch_catalog_checks.c src/assets/serif_14.c src/assets/serif_18.c)
target_sources(native_simulator INTERFACE ${CMAKE_CURRENT_SOURCE_DIR}/src/watch_preferences_host.c)

target_sources(app PRIVATE src/menu_checks.c)

target_sources(app PRIVATE src/assets/montserrat_french_14.c)
```

## prj.conf
```kconfig
CONFIG_DISPLAY=y
CONFIG_INPUT=y
CONFIG_LVGL=y
CONFIG_LV_USE_LABEL=y
CONFIG_LV_USE_BUTTON=y
CONFIG_LV_USE_BAR=y
CONFIG_LV_USE_SLIDER=y
CONFIG_LV_USE_LINE=y
CONFIG_LV_USE_GIF=y
CONFIG_LV_FONT_MONTSERRAT_10=y
CONFIG_LV_FONT_MONTSERRAT_12=y
CONFIG_LV_FONT_MONTSERRAT_14=y
CONFIG_LV_FONT_MONTSERRAT_16=y
CONFIG_LV_FONT_MONTSERRAT_18=y
CONFIG_LV_FONT_MONTSERRAT_22=y
CONFIG_LV_FONT_MONTSERRAT_24=y
CONFIG_LV_FONT_MONTSERRAT_28=y
CONFIG_LV_FONT_MONTSERRAT_34=y
CONFIG_LV_FONT_MONTSERRAT_42=y
CONFIG_LV_FONT_MONTSERRAT_48=y
CONFIG_LV_COLOR_DEPTH_16=y
# Desktop-only: controls, GIF decoding, scaling and circular clipping layers.
# This simulator allocation is not the memory budget for the Nordic firmware.
# Desktop pool includes temporary ARGB layers for fades and the animated menus.
CONFIG_LV_Z_MEM_POOL_SIZE=1048576
CONFIG_LV_Z_VDB_SIZE=10
CONFIG_LV_Z_DOUBLE_VDB=n
CONFIG_MAIN_STACK_SIZE=4096
CONFIG_SDL_DISPLAY_DEFAULT_PIXEL_FORMAT_RGB_565=y
CONFIG_SDL_DISPLAY_ZOOM_PCT=100
CONFIG_SDL_DISPLAY_USE_HARDWARE_ACCELERATOR=n
CONFIG_NATIVE_SIM_SLOWDOWN_TO_REAL_TIME=y
CONFIG_ASSERT=y

CONFIG_LV_FONT_MONTSERRAT_20=y
```

## app.overlay
```dts
&sdl_dc {
    width = <620>;
    height = <420>;
    title = "Dive Watch - LVGL";
};
```

## src/main.c
```c
#include <zephyr/device.h>
#include <zephyr/drivers/display.h>
#include <zephyr/kernel.h>
#include <lvgl.h>
#include "watch_ui.h"
#include "sim_controls.h"
#include "sim_host.h"
#include "sim_layout.h"
#include "sim_checks.h"
#include "sim_dive.h"
#include "apnea_checks.h"
#include "apnea_persistence_checks.h"
#include "apnea_settings_checks.h"
#include "scuba_checks.h"
#include "appearance_checks.h"
#ifdef DIVE_PC_BENCH
#include "pc_bench_ui.h"
#include "pc_bench.h"
#endif

int main(void)
{
    const struct device *display = DEVICE_DT_GET(DT_CHOSEN(zephyr_display));
    if (!device_is_ready(display)) {
        printk("Display unavailable\n");
        return 1;
    }

    struct watch_data data = {
        .depth_dm = 0, .temperature_c = 18, .battery_percent = 87,
    };
    watch_ui_create(sim_controls_create());
    sim_host_init();
#ifdef DIVE_PC_BENCH
    if (sim_host_bench_fresh()!=0) return 1;
    pc_bench_pause(true);
    pc_bench_ui_create();
#endif
    unsigned hour,minute,day,month,weekday,second;
    sim_host_get_clock(&hour, &minute);
    data.clock_hour = hour;
    data.clock_minute=minute;
    sim_host_get_date(&day,&month,&weekday,&second);
    data.clock_day=day;data.clock_month=month;data.clock_weekday=weekday;data.clock_second=second;
    watch_ui_update(&data);
    lv_timer_handler();
    int ret = display_blanking_off(display);
    if (ret < 0 && ret != -ENOSYS) {
        printk("Display blanking error: %d\n", ret);
        return 1;
    }
    printk("LVGL UI ready: 320x300, RGB565, simulated data\n");
    uint64_t last_update = UINT64_MAX;
    struct sim_dive dive = {0};
    int check_stage=0,scale_stage=0,stress_stage=0;
    bool check_done = false;
    bool was_animating = false;
    while (1) {
        appearance_checks_poll(&data);
        sim_checks_poll();
        scuba_checks_poll();
        /* Exercise real SDL events, including wheel outside the crown zone. */
        if (sim_host_check_enabled() && check_stage < 7 &&
            k_uptime_get() >= 100 + check_stage * 120) {
            switch (check_stage++) {
            case 0: sim_host_push_wheel(100, 100, 5); break;
            case 1: sim_host_push_wheel(SIM_PANEL_X + 30, SIM_CROWN_Y + 30, 1); break;
            case 2: sim_host_push_button(SIM_PANEL_X + 30, SIM_TAP_Y + 20, 1); break;
            case 3: sim_host_push_button(SIM_PANEL_X + 30, SIM_TAP_Y + 20, 0); break;
            case 4: sim_host_push_button(SIM_PANEL_X + 30, SIM_DOUBLE_Y + 20, 1); break;
            case 5: sim_host_push_button(SIM_PANEL_X + 30, SIM_DOUBLE_Y + 20, 0); break;
            case 6: sim_host_push_wheel(SIM_PANEL_X + 30, SIM_CROWN_Y + 30, -1); break;
            }
        }
        sim_controls_poll();
#ifdef DIVE_PC_BENCH
        pc_bench_ui_poll();
        pc_bench_checks_poll();
#endif
        if (sim_host_check_enabled() && !check_done && k_uptime_get() >= 1100) {
            /* +1 then -1 should cancel; finish at +1 to check both directions. */
            sim_host_push_wheel(SIM_PANEL_X + 30, SIM_CROWN_Y + 30, 1);
            sim_controls_poll();
            const char *path = sim_host_capture_path();
            if (path) {
                int capture_ret = sim_host_capture(path);
                printk("Screenshot result: %d\n", capture_ret);
            }
            __ASSERT(sim_controls_check_passed(), "Simulator control check failed");
            printk("CONTROL CHECK PASS: crown zone, both directions, single and double tap\n");
            check_done = true;
        }
        if(sim_host_scale_check_enabled()&&scale_stage<9&&k_uptime_get()>=2200+scale_stage*250){
            switch(scale_stage++){
            case 0:__ASSERT(sim_host_get_zoom()==1&&sim_host_zoom_matches(1),"Default scale must be x1");sim_host_push_button(SIM_PANEL_X+30,SIM_ZOOM_Y+20,1);break;
            case 1:sim_host_push_button(SIM_PANEL_X+30,SIM_ZOOM_Y+20,0);break;
            case 2:__ASSERT(sim_host_get_zoom()==2&&sim_host_zoom_matches(2),"Main Scale button failed");break;
            case 3:watch_ui_input(WATCH_CROWN,1);watch_ui_input(WATCH_CROWN,24);watch_ui_input(WATCH_CROWN,-100);watch_ui_input(WATCH_CROWN,WATCH_DIVING);watch_ui_input(WATCH_SINGLE_TAP,0);watch_ui_input(WATCH_CROWN,-100);watch_ui_input(WATCH_SINGLE_TAP,0);break;
            case 4:__ASSERT(watch_ui_view()==WATCH_SCUBA_VIEW,"Scale test scuba missing");break;
            case 5:sim_host_push_button(SIM_PANEL_X+170,394,1);break;
            case 6:sim_host_push_button(SIM_PANEL_X+170,394,0);break;
            case 7:__ASSERT(sim_host_get_zoom()==1&&sim_host_zoom_matches(1),"Scuba Scale button failed");break;
            case 8:printk("SCALE BUTTON PASS: real SDL clicks and window dimensions in both panels\n");break;
            }
        }
        if(sim_host_scale_check_enabled()&&scale_stage==9&&stress_stage<180&&k_uptime_get()>=4500+stress_stage*40){
            unsigned n=stress_stage++,cycle=n/3;
            switch(n%3){
            case 0:sim_host_push_button(SIM_PANEL_X+170,394,1);break;
            case 1:sim_host_push_button(SIM_PANEL_X+170,394,0);break;
            case 2:
                __ASSERT(sim_host_get_zoom()==(cycle%2?1:2)&&sim_host_zoom_matches(cycle%2?1:2),"Scale clicks stopped responding");
                __ASSERT(sim_host_frame_visible(),"Scale produced a black window");break;
            }
            if(stress_stage==180)printk("SCALE STRESS PASS: 60 real clicks, visible frames and responsive controls\n");
        }
        uint64_t now_ms = k_uptime_get(),sample_ms=now_ms;
        bool persistence_step=apnea_persistence_checks_inputs(&sample_ms);
        bool apnea_step=apnea_checks_inputs(&sample_ms);
        bool settings_step=apnea_settings_checks_inputs(&sample_ms);
        if (persistence_step || apnea_step || settings_step || last_update == UINT64_MAX || now_ms - last_update >= 50 ||
            dive.session_active != (watch_ui_view()==WATCH_DIVE_VIEW) ||
            data.depth_dm != sim_controls_depth_dm() ||
            data.heading_degrees != sim_controls_heading_degrees()) {
            data.heading_degrees = sim_controls_heading_degrees();
            /* Session time uses the watch clock, independent of exposure/bench time.
             * Only the freediving tracker resets here; scuba keeps receiving samples. */
            bool freediving=watch_ui_view()==WATCH_DIVE_VIEW;
            sim_dive_session(&dive,&data,sample_ms,freediving);
            data.depth_dm=sim_controls_depth_dm();
            data.depth_mm=sim_controls_depth_mm();data.depth_mm_valid=true;
            if(freediving)sim_dive_update(&dive,&data,sample_ms,data.depth_dm);
            sim_host_get_clock(&hour, &minute);
            data.clock_hour = hour;
            data.clock_minute=minute;
            sim_host_get_date(&day,&month,&weekday,&second);
            data.clock_day=day;data.clock_month=month;data.clock_weekday=weekday;data.clock_second=second;
            watch_ui_update(&data);
            if(persistence_step)apnea_persistence_checks_observe(&data);
            if(apnea_step)apnea_checks_observe(&data);
            if(settings_step)apnea_settings_checks_observe(&data);
            last_update = now_ms;
        }
        /* Desktop-only scaled canvas: redraw during transitions and one
         * final frame to avoid dirty-area rounding leaving cursor trails. */
        bool animating = lv_anim_count_running() != 0;
        if (animating || was_animating) {
            lv_obj_invalidate(lv_screen_active());
        }
        was_animating = animating;
        lv_timer_handler();
        /* Scale changes can happen inside an input callback. Repaint after
         * that callback, and again for delayed native resize/expose events. */
        if(sim_host_take_redraw()) {
            lv_obj_invalidate(lv_screen_active());
            lv_refr_now(NULL);
        }
        k_sleep(K_MSEC(10));
    }
    return 0;
}
```

## src/analog_clock.c
```c
#include "analog_clock.h"
#include "battery_icon.h"
#include "native_fonts.h"
#include <stdio.h>

LV_IMAGE_DECLARE(project_logo_alpha);
struct analog_face {
    lv_obj_t *view,*logo,*date,*battery,*hands;
    enum watch_dial selected;
    struct watch_data data;
};

static lv_point_precise_t point(const lv_area_t *a,int angle,int radius,int side)
{
    return (lv_point_precise_t){
        a->x1+160+((lv_trigo_sin(angle)*radius+lv_trigo_sin(angle+90)*side)>>LV_TRIGO_SHIFT),
        a->y1+150+((-lv_trigo_sin(angle+90)*radius+lv_trigo_sin(angle)*side)>>LV_TRIGO_SHIFT)};
}
static void line(lv_layer_t *layer,const lv_area_t *a,int angle,int start,int end,int width,unsigned color)
{
    lv_draw_line_dsc_t d;lv_draw_line_dsc_init(&d);
    d.p1=point(a,angle,start,0);d.p2=point(a,angle,end,0);
    d.width=width;d.color=lv_color_hex(color);d.opa=LV_OPA_COVER;
    lv_draw_line(layer,&d);
}
static void polygon(lv_layer_t *layer,const lv_area_t *a,int angle,const int (*p)[2],int count,unsigned color)
{
    for(int i=1;i<count-1;i++) {
        lv_draw_triangle_dsc_t d;lv_draw_triangle_dsc_init(&d);
        d.p[0]=point(a,angle,p[0][0],p[0][1]);
        d.p[1]=point(a,angle,p[i][0],p[i][1]);
        d.p[2]=point(a,angle,p[i+1][0],p[i+1][1]);
        d.color=lv_color_hex(color);d.opa=LV_OPA_COVER;lv_draw_triangle(layer,&d);
    }
}
static void disc(lv_layer_t *layer,lv_point_precise_t p,int radius,unsigned color)
{
    lv_draw_rect_dsc_t d;lv_draw_rect_dsc_init(&d);d.radius=LV_RADIUS_CIRCLE;
    d.bg_color=lv_color_hex(color);d.bg_opa=LV_OPA_COVER;
    lv_area_t a={p.x-radius,p.y-radius,p.x+radius,p.y+radius};lv_draw_rect(layer,&d,&a);
}
static void draw_ticks(lv_event_t *e)
{
    struct analog_face *c=lv_event_get_user_data(e);
    lv_area_t a;lv_obj_get_coords(lv_event_get_target_obj(e),&a);
    lv_layer_t *layer=lv_event_get_layer(e);
    if(c->selected==DIAL_MINIMALIST) {
        for(int i=0;i<12;i++)line(layer,&a,i*30,i%3?122:115,133,i%3?2:4,0xffffff);
        return;
    }
    /* The numbered dials share the same sixty one-minute perimeter ticks. */
    for(int i=0;i<60;i++) {
        line(layer,&a,i*6,i%5?137:134,143,i%5?1:2,0xe8e8dd);
        if(c->selected==DIAL_AUTOMATIC && i%5==0 && i)
            disc(layer,point(&a,i*6,137,0),3,0xe4e8d7);
    }
    if(c->selected==DIAL_AUTOMATIC) {
        const int triangle[][2]={{119,-11},{137,0},{119,11}};
        polygon(layer,&a,0,triangle,3,0xe8ebdd);
    }
}
static void draw_hand(struct analog_face *c,lv_layer_t *layer,const lv_area_t *a,int angle,bool minute)
{
    int tip=minute?114:87;
    if(c->selected==DIAL_MINIMALIST) {
        int w=minute?2:3;
        int p[][2]={{22,-w},{tip,-w},{tip,w},{22,w}};
        polygon(layer,a,angle,p,4,0xffffff);
    } else if(c->selected==DIAL_DAUPHINE) {
        int shoulder=minute?51:40,w=minute?6:10;
        int left[][2]={{19,0},{shoulder,-w},{tip,0}};
        int right[][2]={{19,0},{tip,0},{shoulder,w}};
        polygon(layer,a,angle,left,3,0xffffff);polygon(layer,a,angle,right,3,0x888888);
    } else {
        tip=minute?116:86;
        int shoulder=minute?48:36,w=minute?6:9;
        int outer[][2]={{-7,-2},{shoulder,-w},{tip,0},{shoulder,w},{-7,2}};
        int left[][2]={{-5,0},{shoulder,-w},{tip,0}};
        int insert[][2]={{11,-1},{shoulder,-w+3},{tip-12,0},{shoulder,w-3},{11,1}};
        polygon(layer,a,angle,outer,5,0xc4cbd0);polygon(layer,a,angle,left,3,0xf4f4ed);
        polygon(layer,a,angle,insert,5,0xe4e9d7);
    }
}
static void draw_hands(lv_event_t *e)
{
    struct analog_face *c=lv_event_get_user_data(e);
    lv_area_t a;lv_obj_get_coords(lv_event_get_target_obj(e),&a);
    lv_layer_t *layer=lv_event_get_layer(e);
    draw_hand(c,layer,&a,(c->data.clock_hour%12)*30+c->data.clock_minute/2,false);
    draw_hand(c,layer,&a,c->data.clock_minute*6+c->data.clock_second/10,true);
    if(c->selected==DIAL_AUTOMATIC) {
        lv_point_precise_t p=point(&a,0,0,0);disc(layer,p,6,0xe2e5dc);disc(layer,p,2,0x9ba5a8);
    }
}
static lv_obj_t *drawing(struct analog_face *c,lv_event_cb_t callback)
{
    lv_obj_t *o=lv_obj_create(c->view);lv_obj_remove_style_all(o);lv_obj_set_size(o,320,300);
    lv_obj_remove_flag(o,LV_OBJ_FLAG_SCROLLABLE);lv_obj_remove_flag(o,LV_OBJ_FLAG_CLICKABLE);
    lv_obj_add_event_cb(o,callback,LV_EVENT_DRAW_MAIN,c);return o;
}
static void number(struct analog_face *c,int angle,int radius,int value,const lv_font_t *font)
{
    lv_obj_t *n=lv_label_create(c->view);char text[4];snprintf(text,sizeof(text),"%d",value);
    lv_label_set_text(n,text);lv_obj_set_style_text_font(n,font,0);
    lv_obj_set_style_text_color(n,lv_color_hex(0xf1f1e9),0);lv_obj_update_layout(n);
    const lv_area_t origin={0};lv_point_precise_t p=point(&origin,angle,radius,0);
    lv_obj_set_pos(n,p.x-lv_obj_get_width(n)/2,p.y-lv_obj_get_height(n)/2);
}
int analog_clock_logo_y(lv_obj_t *view){struct analog_face *c=lv_obj_get_user_data(view);return c->selected==DIAL_AUTOMATIC?101:90;}
int analog_clock_logo_scale(lv_obj_t *view){struct analog_face *c=lv_obj_get_user_data(view);return c->selected==DIAL_AUTOMATIC?44:60;}
lv_obj_t *analog_clock_logo(lv_obj_t *view){struct analog_face *c=lv_obj_get_user_data(view);return c->logo;}
void analog_clock_set_dial(lv_obj_t *view,enum watch_dial dial)
{
    struct analog_face *c=lv_obj_get_user_data(view);
    if(dial<0 || dial>DIAL_AUTOMATIC)return;
    c->selected=dial;lv_obj_clean(c->view);
    lv_obj_set_style_bg_color(c->view,lv_color_hex(dial==DIAL_AUTOMATIC?0x1b3040:0),0);
    drawing(c,draw_ticks);
    if(dial==DIAL_AUTOMATIC) {
        lv_obj_t *ring=lv_obj_create(c->view);lv_obj_remove_style_all(ring);
        lv_obj_set_pos(ring,70,60);lv_obj_set_size(ring,180,180);
        lv_obj_set_style_border_width(ring,1,0);lv_obj_set_style_border_color(ring,lv_color_hex(0xcbd2cb),0);
        lv_obj_set_style_radius(ring,LV_RADIUS_CIRCLE,0);lv_obj_remove_flag(ring,LV_OBJ_FLAG_SCROLLABLE);
        for(int i=0;i<12;i++)if(i!=3) {
            number(c,i*30,77,i?i:12,&lv_font_montserrat_16);
            if(i)number(c,i*30,113,i*5,&lv_font_montserrat_22);
        }
    } else if(dial==DIAL_DAUPHINE) {
        for(int i=0;i<12;i++) {
            if(i%3==0)number(c,i*30,121,i?i:12,&watch_montserrat_bold_28);
            else number(c,i*30,123,i*5,&lv_font_montserrat_16);
        }
    }
    c->logo=lv_image_create(c->view);lv_image_set_src(c->logo,&project_logo_alpha);
    lv_image_set_scale(c->logo,analog_clock_logo_scale(view));lv_image_set_antialias(c->logo,true);
    lv_obj_set_style_image_recolor(c->logo,lv_color_white(),0);lv_obj_set_style_image_recolor_opa(c->logo,LV_OPA_COVER,0);
    lv_obj_set_pos(c->logo,60,analog_clock_logo_y(view)-209/2);
    c->date=lv_label_create(c->view);lv_obj_set_style_text_font(c->date,&lv_font_montserrat_14,0);
    lv_obj_set_style_text_color(c->date,lv_color_hex(dial==DIAL_AUTOMATIC?0x1a2530:0xffffff),0);
    if(dial==DIAL_AUTOMATIC) {
        lv_obj_set_style_bg_color(c->date,lv_color_hex(0xf3f3e7),0);lv_obj_set_style_bg_opa(c->date,LV_OPA_COVER,0);
        lv_obj_set_style_border_width(c->date,1,0);lv_obj_set_style_border_color(c->date,lv_color_hex(0x939e9e),0);
        lv_obj_set_style_pad_hor(c->date,4,0);lv_obj_set_style_pad_ver(c->date,2,0);
    }
    c->battery=battery_icon_create(c->view,142,dial==DIAL_AUTOMATIC?198:dial==DIAL_DAUPHINE?214:218);
    c->hands=drawing(c,draw_hands);analog_clock_update(view,&c->data);
}
static void release(lv_event_t *e){lv_free(lv_event_get_user_data(e));}
lv_obj_t *analog_clock_create(lv_obj_t *parent)
{
    struct analog_face *c=lv_malloc_zeroed(sizeof(*c));LV_ASSERT_MALLOC(c);
    c->view=lv_obj_create(parent);lv_obj_set_user_data(c->view,c);
    lv_obj_add_event_cb(c->view,release,LV_EVENT_DELETE,c);
    lv_obj_remove_style_all(c->view);lv_obj_set_size(c->view,320,300);
    lv_obj_set_style_bg_opa(c->view,LV_OPA_COVER,0);lv_obj_remove_flag(c->view,LV_OBJ_FLAG_SCROLLABLE);
    analog_clock_set_dial(c->view,DIAL_MINIMALIST);return c->view;
}
void analog_clock_update(lv_obj_t *view,const struct watch_data *data)
{
    struct analog_face *c=lv_obj_get_user_data(view);
    bool changed=data->clock_hour!=c->data.clock_hour || data->clock_minute!=c->data.clock_minute ||
                 data->clock_second!=c->data.clock_second;
    c->data=*data;
    static const char *const days[]={"SUN","MON","TUE","WED","THU","FRI","SAT"};
    lv_label_set_text_fmt(c->date,"%s %02u",days[data->clock_weekday%7],data->clock_day);lv_obj_update_layout(c->date);
    lv_obj_set_pos(c->date,(c->selected==DIAL_AUTOMATIC?236:233)-lv_obj_get_width(c->date)/2,c->selected==DIAL_AUTOMATIC?139:141);
    battery_icon_update(c->battery,data->battery_percent);
    if(changed)lv_obj_invalidate(c->hands);
}
```

## src/analog_clock.h
```c
#pragma once
#include <lvgl.h>
#include "watch_data.h"

enum watch_dial { DIAL_MINIMALIST, DIAL_DAUPHINE, DIAL_AUTOMATIC, DIAL_RADAR, DIAL_POLAR, DIAL_IVORY, DIAL_SOLAR, DIAL_COUNT };
lv_obj_t *analog_clock_create(lv_obj_t *parent);
void analog_clock_set_dial(lv_obj_t *view,enum watch_dial dial);
void analog_clock_update(lv_obj_t *view,const struct watch_data *data);
lv_obj_t *analog_clock_logo(lv_obj_t *view);
int analog_clock_logo_y(lv_obj_t *view);
int analog_clock_logo_scale(lv_obj_t *view);
```

## src/apnea_checks.c
```c
#include "apnea_checks.h"
#include "sim_controls.h"
#include "sim_host.h"
#include "sim_layout.h"
#include "watch_ui.h"
#include <zephyr/kernel.h>
#include <stdio.h>
#include <string.h>
static unsigned step;
static uint64_t clock_ms=100000;
static bool visible_text(lv_obj_t *o,const char *text)
{
    if(lv_obj_has_flag(o,LV_OBJ_FLAG_HIDDEN))return false;
    if(lv_obj_check_type(o,&lv_label_class)&&!strcmp(lv_label_get_text(o),text))return true;
    for(unsigned i=0;i<lv_obj_get_child_count(o);i++)if(visible_text(lv_obj_get_child(o,i),text))return true;
    return false;
}
static void expect(const char *text)
{
    __ASSERT(visible_text(lv_screen_active(),text),"Missing visible apnea value %s at step %u",text,step);
}
static void capture(const char *name)
{
    char path[512];snprintf(path,sizeof(path),"%s/%s.bmp",sim_host_gallery_path(),name);
    lv_refr_now(NULL);__ASSERT(sim_host_capture(path)==0,"Apnea capture failed");
}
#ifdef DIVE_PC_BENCH
#include "pc_bench.h"
/* Public pressure commands pass through main's ordinary freediving sampling.
 * Literal deltas are independently worked for 1.099/1.100, 12.3, 9.9,
 * .300/.299 and 5 m, retaining the existing decimal threshold truncation. */
static bool water_apnea_inputs(uint64_t *sample_ms)
{
    *sample_ms=clock_ms;
    if(step>=24 || k_uptime_get()<10000+(uint64_t)step*400)return false;
    unsigned stage=step%12,salt=step/12;
    /* Capture the preceding observation after LVGL/display timers have painted
     * it, before this step sends another input or changes the pressure. */
    if(stage==4 || stage==7 || stage==11) {
        const char *prefix=sim_host_capture_path();
        if(prefix) {
            char path[512];snprintf(path,sizeof(path),"%s-apnea-%u.bmp",prefix,step-1);
            lv_refr_now(NULL);__ASSERT(!sim_host_capture(path),"Water apnea capture failed");
        }
    }
    static const float pressure[2][10]={
        {1.1077750835f,1.10787315f,2.20621795f,1.97085835f,1.02941995f,1.0293218835f,
         1.0293218835f,1.10787315f,1.4903325f,1},
        {1.1104694605875f,1.11056997875f,2.23637339875f,1.99512980875f,1.03015544875f,1.0300549305875f,
         1.0300549305875f,1.11056997875f,1.5025908125f,1}};
    if(stage==0) {
        __ASSERT(!pc_bench_fresh(1,salt?1025:1000,NULL,0),"Apnea water fixture rejected");
        __ASSERT(!pc_bench_recording_finish(),"Apnea fixture did not disarm scuba recording");
        pc_bench_pause(true);
        watch_ui_input(WATCH_CROWN,-100);watch_ui_input(WATCH_CROWN,WATCH_DIVING);
        watch_ui_input(WATCH_SINGLE_TAP,0);watch_ui_input(WATCH_CROWN,-100);
        watch_ui_input(WATCH_CROWN,1);watch_ui_input(WATCH_SINGLE_TAP,0);
        __ASSERT(watch_ui_view()==WATCH_DIVE_VIEW,"Apnea water journey entry failed");
    } else if(stage==11) {
        watch_ui_input(WATCH_CROWN,3);watch_ui_input(WATCH_CROWN,24);
        __ASSERT(watch_ui_view()==WATCH_MODE_MENU && !pc_bench_set_water(!salt),"Completed apnea session kept water locked");
    } else {
        __ASSERT(!pc_bench_accept_sample(&(ostc4_sample){stage,pressure[salt][stage-1]}),"Apnea physical pressure rejected");
        if(stage==3 || stage==7) {
            watch_ui_input(WATCH_CROWN,2);watch_ui_input(WATCH_SINGLE_TAP,0);
            watch_ui_input(WATCH_CROWN,-100);watch_ui_input(WATCH_SINGLE_TAP,0);
            watch_ui_input(WATCH_CROWN,salt?0:1);watch_ui_input(WATCH_SINGLE_TAP,0);
            __ASSERT(watch_ui_salt_water()==(bool)salt && pc_bench_set_water(!salt)==-1,
                "Underwater or recovery editor changed active water");
            watch_ui_input(WATCH_DOUBLE_TAP,0);watch_ui_input(WATCH_DOUBLE_TAP,0);
            watch_ui_input(WATCH_CROWN,-100);
        }
    }
    clock_ms=100000+(uint64_t)step*1000;*sample_ms=clock_ms;
    return true;
}
static void water_apnea_observe(const struct watch_data *data)
{
    unsigned stage=step%12,salt=step/12;
    if(stage<11)__ASSERT(data->session_density_kg_m3==(salt?1025:1000),"Apnea session water metadata changed");
    if(stage>=6)__ASSERT(data->last_density_kg_m3==(salt?1025:1000),"Apnea completed record water metadata changed");
    if(stage==0)__ASSERT(!data->total_dives && !data->max_depth_dm,"New apnea session retained statistics");
    if(stage==1)__ASSERT(data->depth_dm==10 && !data->apnea_active && !data->total_dives,"Physical 1.099 m started apnea");
    if(stage==2)__ASSERT(data->depth_dm==11 && data->apnea_active && data->total_dives==1,"Physical 1.100 m missed apnea start");
    if(stage==3)__ASSERT(data->depth_dm==123 && data->current_max_depth_dm==123 && data->max_depth_dm==123 && data->apnea_direction==1,"Apnea physical maximum/descent disagreed");
    if(stage==4)__ASSERT(data->depth_dm==99 && data->apnea_direction==-1 && data->max_depth_dm==123,"Apnea physical ascent changed maximum");
    if(stage==5)__ASSERT(data->depth_dm==3 && data->apnea_active,"Physical .300 m ended apnea");
    if(stage==6 || stage==7)__ASSERT(data->depth_dm==2 && !data->apnea_active && data->show_recovery && data->last_depth_dm==123 && data->total_dives==1,"Physical .299 m failed apnea recovery statistics");
    if(stage==8)__ASSERT(data->apnea_active && data->total_dives==2 && data->max_depth_dm==123,"Second immersion lost session state");
    if(stage==9)__ASSERT(data->depth_dm==50 && data->current_max_depth_dm==50 && data->max_depth_dm==123,"Second immersion changed physical session record");
    if(stage==10)__ASSERT(!data->apnea_active && data->last_depth_dm==50 && data->max_depth_dm==123 && data->total_dives==2 && data->total_underwater_s==6,"Surface recovery lost apnea totals");
    if(stage==3 || stage==6 || stage==10) {
        const char *prefix=sim_host_capture_path();
        if(prefix) {
            char path[512];snprintf(path,sizeof(path),"%s-apnea-%u.json",prefix,step);
            FILE *out=fopen(path,"w");__ASSERT(out,"Water apnea observation failed");
            fprintf(out,"{\"density_kg_m3\":%u,\"last_density_kg_m3\":%u,\"depth_dm\":%u,\"current_max_depth_dm\":%u,\"max_depth_dm\":%u,\"last_depth_dm\":%u,\"total_dives\":%u,\"total_underwater_s\":%u,\"elapsed_s\":%u,\"max_dive_s\":%u,\"active\":%s}\n",
                data->session_density_kg_m3,data->last_density_kg_m3,data->depth_dm,data->current_max_depth_dm,data->max_depth_dm,data->last_depth_dm,data->total_dives,data->total_underwater_s,data->elapsed_s,data->max_dive_s,data->apnea_active?"true":"false");
            __ASSERT(!fclose(out),"Water apnea observation close failed");
        }
    }
    if(step==23)printk("WATER APNEA PASS: both densities, physical start/surface thresholds, depth/max/session statistics, two immersions, underwater/recovery water locks, BACK and post-session unlock\n");
    ++step;
}
#endif
bool apnea_checks_inputs(uint64_t *sample_ms)
{
#ifdef DIVE_PC_BENCH
    if(sim_host_bench_check_enabled()==7)return water_apnea_inputs(sample_ms);
#endif
    if(!sim_host_apnea_check_enabled())return false;
    *sample_ms=clock_ms;
    if(step>=47||k_uptime_get()<500+(uint64_t)step*450)return false;
    switch(step) {
    case 0:
        watch_ui_input(WATCH_CROWN,1);watch_ui_input(WATCH_CROWN,24);
        watch_ui_input(WATCH_CROWN,-100);watch_ui_input(WATCH_CROWN,WATCH_DIVING);
        watch_ui_input(WATCH_SINGLE_TAP,0);watch_ui_input(WATCH_CROWN,-100);watch_ui_input(WATCH_CROWN,1);
        watch_ui_input(WATCH_SINGLE_TAP,0);break;
    case 1:break;
    case 2:clock_ms=101000;sim_controls_set_depth_dm(10);break;
    case 3:clock_ms=102000;sim_controls_set_depth_dm(11);break;
    case 4:clock_ms=122000;sim_controls_set_depth_dm(123);break;
    case 5:clock_ms=132000;break;
    case 6:clock_ms=142000;sim_controls_set_depth_dm(99);break;
    case 7:clock_ms=161000;sim_controls_set_depth_dm(3);break;
    case 8:clock_ms=162000;sim_controls_set_depth_dm(2);break;
    case 9:clock_ms=281000;sim_controls_set_depth_dm(1);break;
    case 10:clock_ms=282000;sim_controls_set_depth_dm(2);break;
    case 11:clock_ms=292000;sim_controls_set_depth_dm(0);break;
    case 12:clock_ms=823000;sim_controls_set_depth_dm(2);break;
    case 13:watch_ui_input(WATCH_CROWN,1);break;
    case 14:clock_ms=824000;break;
    case 15:watch_ui_input(WATCH_CROWN,-1);break;
    case 16:clock_ms=825000;sim_controls_set_depth_dm(50);break;
    case 17:clock_ms=1425000;sim_controls_set_depth_dm(1000);break;
    case 18:sim_host_push_button(SIM_PANEL_X+30,SIM_ZOOM_Y+20,1);break;
    case 19:sim_host_push_button(SIM_PANEL_X+30,SIM_ZOOM_Y+20,0);break;
    case 20:clock_ms=1426000;sim_controls_set_depth_dm(1000);break;
    case 21:watch_ui_input(WATCH_CROWN,3);break;
    case 23:clock_ms=1600000;watch_ui_input(WATCH_SINGLE_TAP,0);break;
    case 24:clock_ms=1700000;watch_ui_input(WATCH_SINGLE_TAP,0);break;
    case 25:clock_ms=1701000;break;
    case 26:clock_ms=1702000;sim_host_set_zoom(1);watch_ui_input(WATCH_CROWN,1);break;
    case 27:clock_ms=1703000;break;
    case 28:clock_ms=1704000;sim_controls_set_depth_dm(123);break;
    case 29:clock_ms=1714000;sim_controls_set_depth_dm(200);break;
    case 30:clock_ms=1724000;sim_controls_set_depth_dm(0);break;
    case 31:clock_ms=1725000;watch_ui_input(WATCH_CROWN,-1);break;
    case 32:expect("LAST DEPTH");expect("20.0");capture("stats-main-return");clock_ms=1726000;sim_controls_set_depth_dm(50);watch_ui_input(WATCH_CROWN,1);break;
    case 33:clock_ms=1727000;break;
    case 34:clock_ms=1730000;sim_controls_set_depth_dm(0);break;
    case 35:clock_ms=1731000;sim_controls_set_depth_dm(1000);break;
    case 36:clock_ms=1791000;break;
    case 37:sim_host_push_button(SIM_PANEL_X+30,SIM_ZOOM_Y+20,1);break;
    case 38:sim_host_push_button(SIM_PANEL_X+30,SIM_ZOOM_Y+20,0);break;
    case 39:clock_ms=7791000;break;
    case 40:clock_ms=101731000;break;
    case 41:watch_ui_input(WATCH_CROWN,2);break;
    case 42:clock_ms=101732000;watch_ui_input(WATCH_CROWN,24);sim_controls_set_depth_dm(0);break;
    case 43:clock_ms=101740000;watch_ui_input(WATCH_SINGLE_TAP,0);break;
    case 44:clock_ms=101750000;watch_ui_input(WATCH_SINGLE_TAP,0);break;
    case 45:clock_ms=101751000;watch_ui_input(WATCH_CROWN,1);break;
    case 46:clock_ms=101752000;break;
    case 22:
        watch_ui_input(WATCH_CROWN,24);clock_ms=1500000;
        sim_controls_set_depth_dm(0);
        /* Sample the actual departure before re-entry in a later fixture. */
        break;
    }
    *sample_ms=clock_ms;return true;
}
void apnea_checks_observe(const struct watch_data *data)
{
#ifdef DIVE_PC_BENCH
    if(sim_host_bench_check_enabled()==7){water_apnea_observe(data);return;}
#endif
    switch(step) {
    case 1:expect("--");expect("TEMPERATURE");capture("apnea-01-fresh");break;
    case 2:__ASSERT(data->total_dives==0,"1.0 m started apnea");break;
    case 3:__ASSERT(data->total_dives==1&&data->apnea_active,"1.1 m failed start");break;
    case 4:expect("12.3");expect("0:20");capture("apnea-04-descent");break;
    case 5:expect("0:30");capture("apnea-05-hold");break;
    case 6:expect("9.9");expect("12.3");capture("apnea-06-ascent");break;
    case 7:__ASSERT(data->apnea_active,"0.3 m ended apnea");break;
    case 8:expect("LAST DEPTH");capture("apnea-08-surface");break;
    case 9:__ASSERT(data->recovery_red,"119 s green early");capture("apnea-09-red");break;
    case 10:__ASSERT(!data->recovery_red,"120 s missing green");capture("apnea-10-green");break;
    case 11:__ASSERT(!data->recovery_ring_visible,"130 s ring still visible");capture("apnea-11-expired");break;
    case 12:capture("apnea-12-long-recovery");break;
    case 14:__ASSERT(data->runtime_s==724&&data->total_dives==1,"Page navigation reset session");capture("apnea-14-statistics-no-ring");break;
    case 16:expect("5.0");expect("0:00");__ASSERT(data->max_depth_dm==123&&data->total_dives==2,"Second apnea lost session");break;
    case 17:expect("100.0");expect("10:00");__ASSERT(data->max_dive_s==600,"Live duration record stale");capture("apnea-17-long-x1");break;
    case 20:expect("100.0");expect("10:01");capture("apnea-20-long-x2");break;
    case 25:expect("--");__ASSERT(data->runtime_s==1&&data->total_dives==0&&data->max_depth_dm==0&&!data->show_recovery,"Re-entry retained session");capture("apnea-25-reentry");printk("APNEA MAIN PASS: thresholds, direction, live records, 119/120/130/661 s recovery, page continuity, two apneas, exit/re-entry and x1/x2 renders\n");break;
    case 27:expect("MAX TIME");expect("DIVES");expect("SESSION TIME");expect("--");expect("0");expect("0:00:03");capture("stats-01-fresh");break;
    case 29:expect("20.0");expect("0:10");expect("1");expect("0:00:14");capture("stats-02-live");break;
    case 30:expect("20.0");expect("0:20");expect("0:00:24");capture("stats-03-recovery");break;
    case 31:__ASSERT(data->show_recovery&&data->recovery_s==1,"Statistics reset recovery");break;
    case 33:expect("20.0");expect("0:20");expect("2");expect("0:00:27");capture("stats-04-second-shorter");break;
    case 36:__ASSERT(sim_host_get_zoom()==1,"Statistics x1 fixture wrong");expect("100.0");expect("1:00");expect("3");expect("0:01:31");capture("stats-05-live-record-x1");break;
    case 39:__ASSERT(sim_host_get_zoom()==2,"Statistics x2 fixture wrong");expect("100.0");expect("101:00");expect("1:41:31");capture("stats-06-live-record-x2");break;
    case 40:expect("1666:40");expect("27:47:11");capture("stats-07-long-session");break;
    case 46:expect("--");expect("0");expect("0:00:02");capture("stats-08-reentry");printk("APNEA STATISTICS PASS: initial placeholders, active records, recovery continuity, shorter second apnea, new live depth/time records, long timers, x1/x2 and re-entry\n");break;
    case 22:__ASSERT(watch_ui_view()==WATCH_MODE_MENU,"Leave control changed");break;
    }
    if(step>=8&&step<=12){expect("DIVE TIME");expect("1:00");}
    if((step>=8&&step<=12)||step==1||step==25) {
        __ASSERT(!visible_text(lv_screen_active(),"RECOVERY"),"Recovery timer caption visible");
    }
    step++;
}
```

## src/apnea_checks.h
```c
#pragma once
#include <stdint.h>
#include "watch_data.h"
/* Deterministic native interaction fixtures, using public crown/depth inputs. */
bool apnea_checks_inputs(uint64_t *sample_ms);
void apnea_checks_observe(const struct watch_data *data);
```

## src/apnea_main.c
```c
#include "apnea_main.h"
#include "apnea_settings.h"
#include "dive_layout.h"
#include "native_fonts.h"
#include <stdio.h>

struct apnea_main {
    lv_obj_t *depth,*unit,*left_title,*left,*time_title,*time,*bottom_title,*bottom,*direction;
};
static void deleted(lv_event_t *event){lv_free(lv_event_get_user_data(event));}
static lv_obj_t *label(lv_obj_t *parent,const lv_font_t *font)
{
    lv_obj_t *o=lv_label_create(parent);
    lv_obj_set_style_text_font(o,font,0);lv_obj_set_style_text_color(o,lv_color_white(),0);
    return o;
}
static void centred(lv_obj_t *o,const char *text,int x,int y)
{
    lv_label_set_text(o,text);lv_obj_update_layout(o);
    lv_obj_set_pos(o,x-lv_obj_get_width(o)/2,y);
}
static void direction(lv_event_t *event)
{
    struct apnea_main *m=lv_event_get_user_data(event);
    lv_area_t a;lv_obj_get_coords(m->direction,&a);
    lv_draw_rect_dsc_t ink;lv_draw_rect_dsc_init(&ink);
    ink.bg_color=lv_color_white();ink.bg_opa=LV_OPA_COVER;
    lv_layer_t *layer=lv_event_get_layer(event);
    /* Same five inactive dashes, positions, dimensions and colour as scuba. */
    ink.bg_color=lv_color_hex(0x777777);
    for(int i=0;i<5;i++) {
        lv_area_t dash={a.x1+7,a.y1+3+12*i,a.x1+12,a.y1+5+12*i};
        lv_draw_rect(layer,&ink,&dash);
    }
}
lv_obj_t *apnea_main_create(lv_obj_t *parent)
{
    lv_obj_t *view=lv_obj_create(parent);lv_obj_remove_style_all(view);
    lv_obj_set_size(view,320,300);lv_obj_remove_flag(view,LV_OBJ_FLAG_SCROLLABLE);
    struct apnea_main *m=lv_malloc_zeroed(sizeof(*m));LV_ASSERT_MALLOC(m);
    lv_obj_set_user_data(view,m);lv_obj_add_event_cb(view,deleted,LV_EVENT_DELETE,m);
    m->depth=label(view,&watch_montserrat_60);m->unit=label(view,&lv_font_montserrat_18);lv_label_set_text(m->unit,"m");
    m->left_title=label(view,&lv_font_montserrat_12);m->left=label(view,&lv_font_montserrat_34);
    m->time_title=label(view,&lv_font_montserrat_12);m->time=label(view,&lv_font_montserrat_34);
    m->bottom_title=label(view,&lv_font_montserrat_12);m->bottom=label(view,&lv_font_montserrat_34);
    dive_layout_rails(view,0x33dbd4);
    m->direction=lv_obj_create(view);lv_obj_remove_style_all(m->direction);
    lv_obj_set_pos(m->direction,150,146);lv_obj_set_size(m->direction,20,56);
    lv_obj_remove_flag(m->direction,LV_OBJ_FLAG_SCROLLABLE|LV_OBJ_FLAG_CLICKABLE);
    lv_obj_add_event_cb(m->direction,direction,LV_EVENT_DRAW_MAIN,m);
    return view;
}
void apnea_main_update(lv_obj_t *view,const struct watch_data *data)
{
    struct apnea_main *m=lv_obj_get_user_data(view);char text[48];
    dive_layout_depth(m->depth,m->unit,data->depth_dm);
    centred(m->left_title,data->apnea_active?"MAX DEPTH":"LAST DEPTH",101,127);
    uint16_t peak=data->apnea_active?data->current_max_depth_dm:data->last_depth_dm;
    if(data->apnea_active||data->show_recovery)snprintf(text,sizeof(text),"%u.%u",peak/10,peak%10);
    else snprintf(text,sizeof(text),"--");
    lv_obj_set_style_text_font(m->left,peak>=1000?&lv_font_montserrat_28:&lv_font_montserrat_34,0);
    centred(m->left,text,101,157);
    centred(m->time_title,"DIVE TIME",219,127);
    uint32_t seconds=data->elapsed_s;
    if(data->apnea_active||data->show_recovery)
        snprintf(text,sizeof(text),"%u:%02u",seconds/60,seconds%60);
    else snprintf(text,sizeof(text),"--");
    lv_obj_set_style_text_font(m->time,seconds>=6000?&lv_font_montserrat_22:&lv_font_montserrat_34,0);
    centred(m->time,text,219,157);
    enum apnea_bottom_field field=apnea_settings_bottom_field();
    static const char *const captions[]={"TEMPERATURE","MAX DEPTH","UNDERWATER TIME","CLOCK","DIVES"};
    centred(m->bottom_title,captions[field],160,219);
    switch(field) {
    case APNEA_SESSION_DEPTH:
        if(data->total_dives)snprintf(text,sizeof(text),"%u.%u m",data->max_depth_dm/10,data->max_depth_dm%10);
        else snprintf(text,sizeof(text),"--");
        break;
    case APNEA_SESSION_TIME:
        seconds=data->total_underwater_s;
        snprintf(text,sizeof(text),"%u:%02u",seconds/60,seconds%60);break;
    case APNEA_CLOCK:snprintf(text,sizeof(text),"%02u:%02u",data->clock_hour,data->clock_minute);break;
    case APNEA_DIVE_COUNT:snprintf(text,sizeof(text),"%u",data->total_dives);break;
    default:snprintf(text,sizeof(text),"%d°C",data->temperature_c);break;
    }
    lv_obj_set_style_text_font(m->bottom,field==APNEA_SESSION_TIME&&data->total_underwater_s>=36000?&lv_font_montserrat_22:&lv_font_montserrat_34,0);
    centred(m->bottom,text,160,239);
}
```

## src/apnea_main.h
```c
#pragma once
#include <lvgl.h>
#include "watch_data.h"
lv_obj_t *apnea_main_create(lv_obj_t *parent);
void apnea_main_update(lv_obj_t *view,const struct watch_data *data);
```

## src/apnea_persistence_checks.c
```c
#include "apnea_persistence_checks.h"
#include "apnea_settings.h"
#include "scuba_ui.h"
#include "watch_ui.h"
#include "sim_controls.h"
#include "sim_host.h"
#include <zephyr/kernel.h>
#include <stdio.h>
#include <string.h>
static unsigned step;
static uint64_t clock_ms=100000;
static void click(void){watch_ui_input(WATCH_SINGLE_TAP,0);}
static void turn(int n){watch_ui_input(WATCH_CROWN,n);}
static void back(void){watch_ui_input(WATCH_DOUBLE_TAP,0);}
static void enter(void){turn(1);turn(24);turn(-100);turn(WATCH_DIVING);click();turn(-100);turn(1);click();}
static void editor(bool bottom){turn(2);click();turn(-100);if(bottom)turn(1);click();}
static void main_page(void){back();back();turn(-100);}
static bool visible(lv_obj_t *o,const char *text)
{
 if(!lv_obj_is_visible(o))return false;
 if(lv_obj_check_type(o,&lv_label_class)&&!strcmp(lv_label_get_text(o),text))return true;
 for(unsigned i=0;i<lv_obj_get_child_count(o);i++)if(visible(lv_obj_get_child(o,i),text))return true;
 return false;
}
static void expect(const char *text){__ASSERT(visible(lv_screen_active(),text),"Persistence step%u missing %s",step,text);}
static void capture(const char *name)
{
 char path[512];snprintf(path,sizeof(path),"%s/%s.bmp",sim_host_gallery_path(),name);
 lv_refr_now(NULL);__ASSERT(!sim_host_capture(path),"Persistence capture failed");
}
static const char *caption(int field){static const char *const names[]={"TEMPERATURE","MAX DEPTH","UNDERWATER TIME","CLOCK","DIVES"};return names[field];}
static void fresh_value(int field,const struct watch_data *data){char value[32];if(field==3){snprintf(value,sizeof(value),"%02u:%02u",data->clock_hour,data->clock_minute);expect(value);}else expect(field==1?"--":field==2?"0:00":field==4?"0":"18°C");}
static void live_value(int field,const struct watch_data *data){char value[32];if(field==3){snprintf(value,sizeof(value),"%02u:%02u",data->clock_hour,data->clock_minute);expect(value);}else expect(field==1?"12.3 m":field==2?"1:00":field==4?"1":"18°C");}
bool apnea_persistence_checks_inputs(uint64_t *sample_ms)
{
 int mode=sim_host_apnea_persistence_mode();if(!mode)return false;
 int choice=sim_host_apnea_persistence_choice(),salt=choice/5,field=choice%5;
 *sample_ms=clock_ms;
 if(step>=20||k_uptime_get()<500+(uint64_t)step*300)return false;
 if(mode==1)switch(step){
 case 0:
  /* Confirm the common choice in unlocked scuba preparation before the apnea session. */
  scuba_ui_enter(clock_ms);scuba_ui_input(WATCH_SINGLE_TAP,0);scuba_ui_input(WATCH_CROWN,-100);
  scuba_ui_input(WATCH_SINGLE_TAP,0);scuba_ui_input(WATCH_CROWN,-100);scuba_ui_input(WATCH_CROWN,salt);
  scuba_ui_input(WATCH_SINGLE_TAP,0);scuba_ui_input(WATCH_DOUBLE_TAP,0);
  enter();break;
 case 1:editor(false);turn(-100);turn(!salt);click();main_page();break;
 case 2:editor(true);turn(-100);turn((field+1)%5);click();main_page();editor(true);turn(-100);turn(field);click();main_page();break;
 case 3:clock_ms=101000;sim_controls_set_depth_dm(123);break;
 case 4:clock_ms=161000;sim_controls_set_depth_dm(200);break;
 case 5:clock_ms=162000;sim_controls_set_depth_dm(0);break;
 case 6:editor(false);turn(-100);turn(!salt);back();main_page();break;
 case 7:editor(true);turn(-100);turn((field+1)%5);back();main_page();break;
 case 8:editor(false);turn(-100);turn(!salt);break;
 case 9:clock_ms=163000;sim_controls_set_depth_dm(150);break;
 case 10:click();main_page();break;
 case 11:clock_ms=233000;sim_controls_set_depth_dm(0);break;
 case 12:editor(true);turn(-100);turn((field+1)%5);break;
 case 13:clock_ms=234000;sim_controls_set_depth_dm(160);break;
 case 14:click();main_page();break;
 case 15:clock_ms=235000;sim_controls_set_depth_dm(0);break;
 }
 else switch(step){
 case 0:
  turn(1);turn(24);turn(-100);turn(WATCH_DIVING);click();turn(-100);click();
  expect(salt?"AIR  |  MARINE":"AIR  |  FRESH");capture("restored-scuba");
  turn(2);turn(24);click();turn(-100);turn(1);click();break;
 case 2:turn(1);break;
 case 4:turn(-1);clock_ms=101000;sim_controls_set_depth_dm(123);break;
 case 5:clock_ms=161000;break;
 case 6:turn(1);break;
 case 8:turn(-1);break;
 case 10:clock_ms=162000;sim_controls_set_depth_dm(0);break;
 case 11:editor(false);break;
 case 13:main_page();break;
 case 14:turn(3);turn(24);break;
 case 15:clock_ms=300000;break;
 case 16:click();break;
 case 17:clock_ms=400000;click();break;
 }
 *sample_ms=clock_ms;return true;
}
void apnea_persistence_checks_observe(const struct watch_data *data)
{
 int mode=sim_host_apnea_persistence_mode(),choice=sim_host_apnea_persistence_choice();
 int salt=choice/5,field=choice%5;
 if(mode==1){
  if(step==16){expect(caption(field));__ASSERT(watch_ui_salt_water()==salt&&apnea_settings_bottom_field()==field,"Cancelled or underwater edit changed applied preferences");capture("saved-main");}
  if(step==19)printk("APNEA PERSISTENCE SAVE PASS: choices%d/%d, cancellation and editors crossing immersion\n",salt,field);
 }else switch(step){
 case 1:__ASSERT(scuba_ui_model()->salt_water==salt,"Shared preference missing from scuba startup");expect(caption(field));fresh_value(field,data);__ASSERT(watch_ui_salt_water()==salt,"Water preference not restored");__ASSERT(data->total_dives==0&&!data->show_recovery&&data->runtime_s==0,"Restart restored session history");capture("restored-main");break;
 case 3:expect("SESSION TIME");expect("--");expect("0");capture("restored-statistics");break;
 case 5:expect(caption(field));live_value(field,data);capture("live-main");break;
 case 7:expect("12.3");expect("1:00");expect("1");expect("0:01:01");capture("live-statistics");break;
 case 9:expect(caption(field));live_value(field,data);capture("returned-main");break;
 case 12:expect("WATER TYPE");__ASSERT(watch_ui_salt_water()==salt,"Loaded water selection wrong");capture("restored-water");break;
 case 18:expect(caption(field));fresh_value(field,data);__ASSERT(watch_ui_salt_water()==salt&&data->total_dives==0&&!data->show_recovery&&data->runtime_s==0,"Session reset lost preferences or retained history");capture("reentry-main");break;
 case 19:printk("APNEA PERSISTENCE LOAD PASS: choices%d/%d, fresh session, Main/Statistics/Main live record agreement and reset\n",salt,field);break;
 }
 step++;
}
```

## src/apnea_persistence_checks.h
```c
#pragma once
#include "watch_data.h"
bool apnea_persistence_checks_inputs(uint64_t *sample_ms);
void apnea_persistence_checks_observe(const struct watch_data *data);
```

## src/apnea_settings.h
```c
#pragma once
#include "watch_ui.h"
enum apnea_bottom_field { APNEA_TEMPERATURE, APNEA_SESSION_DEPTH, APNEA_SESSION_TIME, APNEA_CLOCK, APNEA_DIVE_COUNT, APNEA_BOTTOM_COUNT };
lv_obj_t *apnea_settings_create(lv_obj_t *parent);
void apnea_settings_update(bool underwater);
bool apnea_settings_input(enum watch_input input,int steps);
void apnea_settings_leave(void);
bool apnea_settings_salt_water(void);
enum apnea_bottom_field apnea_settings_bottom_field(void);
/* Startup adapter restores only applied preferences, never session data. */
void apnea_settings_restore(bool salt,enum apnea_bottom_field field);

bool apnea_settings_selection_within_page(void);
```

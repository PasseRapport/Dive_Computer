## V2/Firmware/boards/nordic/dc_v2_1/board.yml
```yaml
board:
  name: dc_v2_1
  full_name: Dive Computer V2 rev 1
  vendor: nordic
  socs:
  - name: nrf52833
```

## V2/Firmware/build/Firmware/Kconfig/Kconfig.shield.defconfig
```kconfig
osource "/home/Bilal/Documents/GitHub/Dive_Computer/V2/Firmware/boards/shields/*/Kconfig.defconfig"
osource "/home/Bilal/ncs/v3.4.1/nrf/boards/shields/*/Kconfig.defconfig"
```

## V2/Firmware/build/Firmware/Kconfig/arch/Kconfig.tmp
```kconfig
# Load Zephyr Arch Kconfig descriptions.
osource "/home/Bilal/ncs/v3.4.1/zephyr/arch/rx/Kconfig"
osource "/home/Bilal/ncs/v3.4.1/zephyr/arch/x86/Kconfig"
osource "/home/Bilal/ncs/v3.4.1/zephyr/arch/xtensa/Kconfig"
osource "/home/Bilal/ncs/v3.4.1/zephyr/arch/sparc/Kconfig"
osource "/home/Bilal/ncs/v3.4.1/zephyr/arch/riscv/Kconfig"
osource "/home/Bilal/ncs/v3.4.1/zephyr/arch/posix/Kconfig"
osource "/home/Bilal/ncs/v3.4.1/zephyr/arch/openrisc/Kconfig"
osource "/home/Bilal/ncs/v3.4.1/zephyr/arch/mips/Kconfig"
osource "/home/Bilal/ncs/v3.4.1/zephyr/arch/arm64/Kconfig"
osource "/home/Bilal/ncs/v3.4.1/zephyr/arch/arm/Kconfig"
osource "/home/Bilal/ncs/v3.4.1/zephyr/arch/arc/Kconfig"
```

## V2/Firmware/build/Kconfig/boards/Kconfig.dc_v2_1.tmp
```kconfig
# Load board Kconfig descriptions.
osource "/home/Bilal/Documents/GitHub/Dive_Computer/V2/Firmware/boards/nordic/dc_v2_1/Kconfig.dc_v2_1"
```

## V2/Firmware/build/Kconfig/boards/Kconfig.defconfig.tmp
```kconfig
# Load Zephyr board defconfig descriptions.
osource "/home/Bilal/Documents/GitHub/Dive_Computer/V2/Firmware/boards/nordic/dc_v2_1/Kconfig.defconfig"
```
